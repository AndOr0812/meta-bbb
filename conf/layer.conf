## conf/layer.conf
```bitbake
# We have a conf and classes directory, add to BBPATH
BBPATH .= ":${LAYERDIR}"

# We have a recipes-* directories, add to BBFILES
BBFILES += "${LAYERDIR}/recipes-*/*/*.bb \
	${LAYERDIR}/recipes-*/*/*.bbappend"

BBFILE_COLLECTIONS += "bbb"
BBFILE_PATTERN_bbb = "^${LAYERDIR}/"
BBFILE_PRIORITY_bbb = "6"
```

## conf/machine/bbb.conf
```bitbake
#@TYPE: Machine
#@NAME: bbb 

#@DESCRIPTION: Machine configuration for bbb (beaglebone black) systems


# Ship all kernel modules by default
MACHINE_EXTRA_RRECOMMENDS = " kernel-modules"

# Allow for MMC booting
EXTRA_IMAGEDEPENDS += "u-boot"

# Uncomment the following line to enable the hard floating point abi. Note that
# this breaks some binary libraries and 3D (neither of which ship with
# meta-yocto). For maximum compatibility, leave this disabled.
#DEFAULTTUNE ?= "cortexa8hf-neon"
include conf/machine/include/tune-cortexa8.inc


IMAGE_FSTYPES ?= "tar.bz2 ext3 bbb-sdimg"

#IMAGE_FSTYPES += "jffs2"
#EXTRA_IMAGECMD_jffs2 = "-lnp "

IMAGE_CLASSES += "sdcard_image-bbb"



# 2.6.37 and later kernels use OMAP_SERIAL, ttyO2
# earlier kernels use ttyS2
# tty on Beaglebones are named ttyO (that's with an uppercase 'o', not a zero!), eg. ttyO0!
SERIAL_CONSOLE = "115200 ttyO0"

#PREFERRED_PROVIDER_virtual/kernel ?= "linux-yocto-dev"
PREFERRED_PROVIDER_virtual/kernel ?= "linux-bbb"


#BBB has no hardware clock
MACHINE_FEATURES_BACKFILL_CONSIDERED = "rtc"


KERNEL_IMAGETYPE = "zImage"
KERNEL_DEVICETREE = "${S}/arch/arm/boot/dts/am335x-boneblack.dts"

SPL_BINARY = "MLO"
UBOOT_SUFFIX = "img"
#UBOOT_MACHINE = "am335x_evm_config"
UBOOT_MACHINE = "am335x_boneblack_config"
UBOOT_ENTRYPOINT = "0x80008000"
UBOOT_LOADADDRESS = "0x80008000"

#MACHINE_FEATURES = "usbgadget usbhost vfat alsa"
MACHINE_FEATURES = "usbhost vfat bluetooth serial usbgadget "
```
